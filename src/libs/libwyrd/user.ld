ENTRY(_start)

SECTIONS {
   . = 0x00400000;

   .text : ALIGN(0x1000) {
      *(.text*)
   }

   .rodata : ALIGN(0x1000) {
      *(.rodata*)
   }

   .data : ALIGN(0x1000) {
      *(.data*)
   }

   .bss : ALIGN(0x1000) {
      *(.bss*)
      *(COMMON)
   }

   /DISCARD/ : {
      *(.comment)
      *(.note*)
      *(.eh_frame*)
   }

   . = ALIGN(0x1000);
   PROVIDE(_end = .);
}
